## conf/machine/kria-combined.conf
```bitbake
#@TYPE: Machine
#@NAME: Combined image for K26/K24
#@DESCRIPTION: Combined image for Kria Starter kits

#### Preamble
MACHINEOVERRIDES =. "${@['', 'kria-combined:']['kria-combined' != '${MACHINE}']}"
#### Regular settings follow

require conf/machine/zynqmp-eg-generic.conf
require conf/machine/include/kria-common.inc

PREFERRED_PROVIDER_virtual/dtb = "device-tree-precompiled"

INITRAMFS_IMAGE ?= "kria-image-initramfs"
INITRAMFS_FSTYPES += "cpio.gz.u-boot"
RAMDISK_IMAGE1 = "${INITRAMFS_IMAGE}-${MACHINE}.cpio.gz.u-boot"

IMAGE_BOOT_FILES = "Image ${INITRAMFS_IMAGE}-${MACHINE}.cpio.gz.u-boot boot.scr"
IMAGE_BOOT_FILES += "devicetree/SMK-*.dtb;devicetree/"
IMAGE_BOOT_FILES += "devicetree/*.dtbo;devicetree/"

EXTRA_IMAGEDEPENDS:remove = " \
    arm-trusted-firmware \
    board-id-data \
    qemu-devicetrees \
    u-boot-xlnx-uenv \
    virtual/boot-bin \
    virtual/bootloader \
    virtual/fsbl \
    virtual/pmu-firmware \
"

WKS_FILE_DEPENDS:remove = "virtual/boot-bin"
MACHINE_ESSENTIAL_EXTRA_RDEPENDS:remove = "xilinx-bootbin u-boot-xlnx-bin"

# Not required as we will not be building any firmware components or DTBs
HDF_MACHINE = "none"

#### No additional settings should be after the Postamble
#### Postamble
PACKAGE_EXTRA_ARCHS:append = "${@['', ' kria_combined']['kria-combined' != "${MACHINE}"]}"
```
